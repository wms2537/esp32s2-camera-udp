## main/Kconfig.projbuild
```kconfig
menu "Example Configuration"

    choice IP_MODE
        prompt "IP Version"
        depends on SOCKET_IP_INPUT_STRING
        help
            Example can use either IPV4 or IPV6.

        config IPV4
            bool "IPV4"

        config IPV6
            bool "IPV6"
            select CONNECT_IPV6

    endchoice

    config WIFI_SSID
        string "WIFI SSID"
        help
            SSID of WIFI to connect to.

    config WIFI_PASS
        string "WIFI Password"
        help
            WiFI password.

    config IPV4_ADDR
        string "IPV4 Address"
        default "192.168.0.121"
        depends on IPV4
        help
            IPV4 address to which the client example will send data.

    config IPV6_ADDR
        string "IPV6 Address"
        default "FE80::30AD:E57B:C212:68AD"
        depends on IPV6
        help
            IPV6 address to which the client example will send data.

    config PORT
        int "Port"
        range 0 65535
        default 3333
        help
            The remote port to which the client example will send data.

    choice SOCKET_IP_INPUT
        prompt "Socket example source"
        default SOCKET_IP_INPUT_STRING
        help
            Selects the input source of the IP used in the example.

        config SOCKET_IP_INPUT_STRING
            bool "From string"

        config SOCKET_IP_INPUT_STDIN
            bool "From stdin"
    endchoice

endmenu
```
